## app/dts/bindings/behaviors/zmk,behavior-button-press.yaml
```yaml
# Copyright (c) 2020 The ZMK Contributors
# SPDX-License-Identifier: MIT

description: Button press/release behavior

compatible: "zmk,behavior-button-press"

include: one_param.yaml
```
