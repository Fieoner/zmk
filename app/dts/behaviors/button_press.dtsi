/*
 * Copyright (c) 2020 The ZMK Contributors
 *
 * SPDX-License-Identifier: MIT
 */

/ {
	behaviors {
		/omit-if-no-ref/ bp: behavior_button_press {
			compatible = "zmk,behavior-button-press";
			label = "BUTTON_PRESS";
			#binding-cells = <1>;
		};
	};
};
